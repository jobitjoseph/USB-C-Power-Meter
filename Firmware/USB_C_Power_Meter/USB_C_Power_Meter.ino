/*
 * Project Name: USB-C Power Meter
 * Project Brief: Firmware for an inline USB-C power meter built around ATSAMD21G18A and PAC1811
 *                Display: ST7735 160x80 IPS · Power monitor: PAC1811T-2E
 * Author: Jobit Joseph
 * Copyright © Jobit Joseph
 * Copyright © Semicon Media Pvt Ltd
 * Copyright © Circuitdigest.com
 *
 * Permission is hereby granted, free of charge, to any person obtaining a copy
 * of this software and associated documentation files (the "Software"), to deal
 * in the Software without restriction, including without limitation the rights
 * to use, copy, modify, merge, publish, distribute, sublicense, and/or sell
 * copies of the Software, and to permit persons to whom the Software is
 * furnished to do so, subject to the following conditions:
 *
 * The above copyright notice and this permission notice shall be included in
 * all copies or substantial portions of the Software.
 *
 * THE SOFTWARE IS PROVIDED "AS IS", WITHOUT WARRANTY OF ANY KIND, EXPRESS OR
 * IMPLIED, INCLUDING BUT NOT LIMITED TO THE WARRANTIES OF MERCHANTABILITY,
 * FITNESS FOR A PARTICULAR PURPOSE AND NONINFRINGEMENT. IN NO EVENT SHALL THE
 * AUTHORS OR COPYRIGHT HOLDERS BE LIABLE FOR ANY CLAIM, DAMAGES OR OTHER
 * LIABILITY, WHETHER IN AN ACTION OF CONTRACT, TORT OR OTHERWISE, ARISING FROM,
 * OUT OF OR IN CONNECTION WITH THE SOFTWARE OR THE USE OR OTHER DEALINGS IN
 * THE SOFTWARE.
 *
 * Required libraries (all available in the Arduino Library Manager):
 *   - Adafruit GFX Library (by Adafruit) — graphics primitives + GFXcanvas16
 *   - Adafruit ST7735 and ST7789 Library (by Adafruit) — display driver
 *   - PAC1xxx (by Jobit Joseph) — PAC1811 power monitor driver
 *   - TemperatureZero (by Electronic Cats) — SAMD21 internal temperature sensor
 *
 * Board: Adafruit SAMD Boards → Adafruit Feather M0
 * Note:  short JP1 and JP2 to program over the USB-C port; remove for normal use.
 *
 * To rearrange, enable or disable screens, edit the SCREENS[] array in the
 * "SCREEN REGISTRY" section below — nothing else needs to change.
 */

#include <Arduino.h>
#include <Wire.h>
#include <Adafruit_GFX.h>
#include <Adafruit_ST7735.h>
// Pre-rendered glyphs instead of the built-in 5x7 font scaled up by
// integer factors. The largest face that fits each value box is picked
// at runtime — see pickFont().
#include <Fonts/FreeSansBold9pt7b.h>
#include <Fonts/FreeSansBold12pt7b.h>
#include <Fonts/FreeSansBold18pt7b.h>
#include <Fonts/FreeSansBold24pt7b.h>
#include <PAC1xxx.h>
#include <TemperatureZero.h>

// ============================================================
//  PIN MAP & CONFIG — ATSAMD21G18A-MFT
// ============================================================

// ST7735 160x80 IPS display — software SPI (MOSI/SCK are plain GPIO,
// not the hardware SPI pins). CS is tied to GND on the board, so it is
// passed to the display library as -1.
#define TFT_CS   -1     // tied to GND on the board
#define TFT_DC    A4    // RS / DC          (PA05)
#define TFT_RST   8     // RST              (PA06)
#define TFT_BL    9     // Backlight (PWM)  (PA07)
#define TFT_MOSI  1     // MOSI             (PA10)
#define TFT_SCK   0     // SCK              (PA11)

#define TFT_W 160
#define TFT_H 80

// This panel presents RGB as its bitwise complement. invertDisplay(true)
// corrects it; a BGR/RGB MADCTL swap does not.
#define TFT_INVERT true

// This panel's column driver runs opposite to what INITR_MINI160x80
// assumes, so every rotation needs its MX bit (0x40) flipped from the
// library's stock value. Stock per-rotation MADCTL is (MX|MY, MY|MV,
// 0x00, MX|MV) for rotations 0..3; with MX flipped that becomes
// (MY, MY|MV|MX, MX, MV) = (0x80, 0xE0, 0x40, 0x20). Only rotation 1
// (landscape) and rotation 3 (the same view flipped 180°) are used.
#define TFT_MADCTL_LANDSCAPE      0xE0 // rotation 1, MX flipped from stock MY|MV
#define TFT_MADCTL_LANDSCAPE_180  0x20 // rotation 3, MX flipped from stock MX|MV

// RAM address offsets. The library's rotation-1 defaults for this panel
// are x=0, y=24, but flipping MX (above) moves where the offsets belong
// and leaves a thin unwritten strip at the right and bottom edges.
// x=1 centres the 160px window in the driver's 162px RAM; y=26 matches
// the 26-row variant of this panel. Both values are the exact centre of
// their axis (162-160=2 -> 1, 132-80=52 -> 26), so the same offsets hold
// in the 180°-flipped orientation and the flip needs only the MADCTL swap.
// If a sliver remains on an edge, nudge that axis by ±1–2: a larger value
// moves the image toward that edge, a smaller one away from it.
#define TFT_X_OFFSET 1
#define TFT_Y_OFFSET 26

// Buttons — active LOW, with external 10k pull-ups on the board, so the
// internal pull-ups are left disabled.
// PA13/PA14/PA15 are not usable via Arduino's pin API on this board
// profile: variant.h caps PINS_COUNT at 26, so even though PA13 has an
// entry further down in variant.cpp's g_APinDescription[] table,
// pinMode(), digitalRead() and attachInterrupt() only recognise pins
// 0..25. These three are therefore driven with direct SAMD21 PORT
// register access — see gpioInput() and gpioActiveLow() below.
#define SW_NEXT_BIT  13   // PA13
#define SW_ROT_BIT   14   // PA14 — tap = flip display 180°, hold 1.5s = reset
#define SW_PREV_BIT  15   // PA15

// PAC1811T-2E power monitor — I2C on the board's default SDA/SCL
#define PAC1811_I2C_ADDR   0x40
#define PAC1811_SHUNT_MOHM 10.0f   // 10 milliohm shunt (R4)

// How often the power sensor is sampled and integrated for mAh/Wh (ms)
#define SAMPLE_INTERVAL_MS  100

// Boot animation timing (ms)
#define BOOT_LOGO_MS      650   // scale/fade-in duration
#define BOOT_BAR_MS       1100  // progress bar fill duration
#define BOOT_HOLD_MS      250   // hold after bar completes before switching to dashboard

// ============================================================
//  BUTTON TYPE + GPIO HELPERS
// ============================================================
// Declared before any function in the file: the IDE inserts its
// auto-generated prototypes right before the first function definition,
// so any type used in a later function signature must exist by here.
struct Button {
  uint8_t pinBit;
  bool stable;
  bool lastRaw;
  unsigned long lastChangeMs;
  unsigned long pressStartMs;
  bool holdFired;
  Button(uint8_t b) : pinBit(b), stable(false), lastRaw(false),
    lastChangeMs(0), pressStartMs(0), holdFired(false) {}
};

// PA13/PA14/PA15 are not on this board profile's pin table (variant.h
// caps PINS_COUNT at 26), so they are configured and read through the
// SAMD21 PORT registers instead of pinMode()/digitalRead().
static inline void gpioInput(uint8_t bit) {
  PORT->Group[0].DIRCLR.reg = (1u << bit);
  PORT->Group[0].PINCFG[bit].bit.INEN = 1;
  PORT->Group[0].PINCFG[bit].bit.PULLEN = 0; // external pull-ups already present
  PORT->Group[0].PINCFG[bit].bit.PMUXEN = 0;
}
static inline bool gpioActiveLow(uint8_t bit) {
  return !(PORT->Group[0].IN.reg & (1u << bit));
}

// Defined in the BUTTONS section near the bottom, where Screens and
// PowerSensor are available. Forward-declared here because
// Display::present() calls it between SPI strips.
void handleButtons();

// ============================================================
//  COLOUR PALETTE (RGB565)
// ============================================================

#define BG_BLACK      0x0000
#define WHITE         0xFFFF
#define LABEL_COLOR   0xFFFF   // small captions / tag text
#define LINE_COLOR    0x2146   // hairline divider between duo-screen rows
#define DOT_DIM       0x1926   // inactive page-indicator dot
#define DOT_ON        V_COLOR  // active page-indicator dot

#define V_COLOR       0x3EBF   // voltage — cyan
#define I_COLOR       0xFDA9   // current — amber
#define P_COLOR       0x5734   // power — green
#define T_COLOR       0xC4DF   // temperature — violet
#define MAH_COLOR     0xFAF6   // charge — pink
#define WH_COLOR      0xFE87   // energy / session time — gold
// Unit suffixes currently track the value colour; give these separate
// darker values to render units dimmer than their digits.
#define V_COLOR_DIM   0x3EBF
#define I_COLOR_DIM   0xFDA9
#define P_COLOR_DIM   0x5734
#define T_COLOR_DIM   0xC4DF
#define MAH_COLOR_DIM 0xFAF6
#define WH_COLOR_DIM  0xFE87

// ============================================================
//  SENSOR READINGS
// ============================================================
#define GRAPH_POINTS 30 // ~30s history at 1 sample/sec for the graph screens

struct Readings {
  float voltage = 0, current = 0, power = 0;     // live
  float vMin = 0, vMax = 0, vAvg = 0;
  float iMin = 0, iMax = 0, iAvg = 0;
  float pMin = 0, pMax = 0, pAvg = 0;
  float mAh = 0;                                  // charge from the PAC1811 hardware accumulator
  float Wh = 0;                                   // derived: (mAh/1000) * vAvg
  float temperatureC = 0;                         // SAMD21 die temperature
  uint32_t sessionSeconds = 0;
  float vHist[GRAPH_POINTS] = {0};
  float iHist[GRAPH_POINTS] = {0};
  float pHist[GRAPH_POINTS] = {0};
  uint8_t histCount = 0;                          // how many of the above are valid yet
};

// ============================================================
//  BOOT LOGO — 140x38 RGB565 bitmap, composited on white
// ============================================================
#define LOGO_W 140
#define LOGO_H 38
static const uint16_t LOGO_BITMAP[LOGO_W * LOGO_H] PROGMEM = {
  65535,65535,65535,65535,65535,65535,65535,65535,65535,65535,61277,14823,
  4258,46486,65535,65535,63422,25356,32,38034,65535,65535,65535,31727,
  32,27501,65503,65535,65535,65535,65535,65535,65535,65535,65535,65535,
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  65535,65535,65535,65535,
};

// ============================================================
//  DISPLAY — ST7735 driver wrapper + auto-fit big-digit rendering
// ============================================================
namespace Display {

struct Series {
  const float *data;
  uint8_t count;
  uint16_t color;
  bool fill;
};

// The library keeps the panel's RAM address offsets (_xstart/_ystart)
// protected with no public setter, and computes them for the un-flipped
// MADCTL. Flipping MX reverses the scan direction and moves where those
// offsets belong, so the window lands a couple of pixels off. This thin
// subclass exposes a setter to correct them after the MADCTL override.
class ST7735Fixed : public Adafruit_ST7735 {
public:
  ST7735Fixed(int8_t cs, int8_t dc, int8_t mosi, int8_t sclk, int8_t rst)
      : Adafruit_ST7735(cs, dc, mosi, sclk, rst) {}
  void setOffsets(int16_t xstart, int16_t ystart) {
    _xstart = xstart;
    _ystart = ystart;
  }
};

ST7735Fixed tft(TFT_CS, TFT_DC, TFT_MOSI, TFT_SCK, TFT_RST);

static bool flipped180 = false;

// Re-applies the rotation, the MADCTL override and the RAM offsets for
// the current orientation. Both orientations are 160x80 landscape,
// scanned in opposite directions; the offsets are identical for both
// because the panel sits centred in the driver RAM.
static void applyRotation() {
  tft.setRotation(flipped180 ? 3 : 1);
  uint8_t madctl = flipped180 ? TFT_MADCTL_LANDSCAPE_180 : TFT_MADCTL_LANDSCAPE;
  tft.sendCommand(ST77XX_MADCTL, &madctl, 1);
  tft.setOffsets(TFT_X_OFFSET, TFT_Y_OFFSET);
}

// Tap on the middle button: flip the whole UI 180°. The next
// Screens::draw() repaints every pixel, so no explicit clear is needed.
void toggleFlip() {
  flipped180 = !flipped180;
  applyRotation();
}

void begin() {
  pinMode(TFT_BL, OUTPUT);
  digitalWrite(TFT_BL, HIGH);

  // INITR_MINI160x80 is the standard init sequence for 160x80 ST7735 IPS
  // panels. If colours come out wrong or offset, try INITR_MINI160x80_PLUGIN
  // here first.
  tft.initR(INITR_MINI160x80);

  // See TFT_INVERT.
  tft.invertDisplay(TFT_INVERT);

  applyRotation();

  tft.cp437(true); // standard CP437 glyph mapping, so 0xF8 renders as the degree sign
  tft.fillScreen(BG_BLACK);
}

// Flicker-free redraw: the whole 160x80 frame is composed in this
// off-screen canvas and pushed to the panel in one SPI burst via
// present(), rather than clearing the live screen and redrawing over it.
// 160*80*2 = 25,600 bytes of the SAMD21G18A's 32KB SRAM, leaving ~7KB for
// globals, sensor state and the call stack. If the allocation ever fails,
// GFXcanvas16 degrades to a no-op on every draw call rather than
// corrupting memory.
static GFXcanvas16 canvas(TFT_W, TFT_H);

void clearScreen(uint16_t bg = BG_BLACK) { canvas.fillScreen(bg); }

// Pushes the composed frame to the panel in one batched SPI burst. Call
// once per redraw, after all of that frame's drawXxx() calls.
//
// This deliberately avoids tft.drawRGBBitmap(): that helper writes the
// frame one pixel at a time through writePixel(), each call re-sending
// the address window. Over software SPI that costs on the order of a
// second per 160x80 frame, during which loop() never returns and button
// polling stalls. setAddrWindow() + writePixels() streams the contiguous
// canvas buffer in a single burst instead.
void present() {
  // Streamed in strips with a button poll between each. Even batched, a
  // full frame over bit-banged SPI takes long enough that a quick tap can
  // start and end entirely inside one present() call and never be seen by
  // loop()'s poll. Polling every 10 rows keeps the gap between button
  // samples to a few milliseconds.
  uint16_t *buf = canvas.getBuffer();
  const int STRIP_ROWS = 10;
  for (int y = 0; y < TFT_H; y += STRIP_ROWS) {
    int h = (TFT_H - y) < STRIP_ROWS ? (TFT_H - y) : STRIP_ROWS;
    tft.startWrite();
    tft.setAddrWindow(0, y, TFT_W, h);
    tft.writePixels(buf + (uint32_t)y * TFT_W, (uint32_t)TFT_W * h);
    tft.endWrite();
    handleButtons(); // safe: only flips state flags, never draws
  }
}

// Largest integer text-size (1..maxSize) whose bounding box fits within
// availW x availH, using the built-in 5x7 font — the fallback for boxes
// too small for even the smallest smooth font below.
static uint8_t fitSize(const char *text, int availW, int availH, uint8_t maxSize) {
  int16_t x1, y1;
  uint16_t w, h;
  canvas.setFont(nullptr);
  canvas.setTextSize(1);
  canvas.getTextBounds(text, 0, 0, &x1, &y1, &w, &h);
  if (w < 1) w = 1;
  if (h < 1) h = 1;
  uint8_t byW = availW / w;
  uint8_t byH = availH / h;
  uint8_t s = byW < byH ? byW : byH;
  if (s < 1) s = 1;
  if (s > maxSize) s = maxSize;
  return s;
}

// Value fonts, largest first. Values render with the biggest of these
// whose glyphs fit the box at native size; custom GFX fonts must never be
// integer-scaled. If even 9pt does not fit, fall back to the scaled
// built-in font.
static const GFXfont *BIG_FONTS[] = {
    &FreeSansBold24pt7b, &FreeSansBold18pt7b, &FreeSansBold12pt7b, &FreeSansBold9pt7b};

static const GFXfont *pickFont(const char *text, int availW, int availH, int extraW) {
  for (uint8_t i = 0; i < sizeof(BIG_FONTS) / sizeof(BIG_FONTS[0]); i++) {
    canvas.setFont(BIG_FONTS[i]);
    canvas.setTextSize(1);
    int16_t x1, y1;
    uint16_t w, h;
    canvas.getTextBounds(text, 0, 0, &x1, &y1, &w, &h);
    if ((int)w + extraW <= availW && (int)h <= availH) return BIG_FONTS[i];
  }
  canvas.setFont(nullptr);
  return nullptr;
}

void drawValueUnit(const char *value, const char *unit,
                    uint16_t valueColor, uint16_t unitColor,
                    int cx, int cy, int availW, int availH,
                    uint8_t maxSize) {
  // The FreeSans faces are ASCII-only, so the CP437 degree glyph (\xF8)
  // used by the temperature screen cannot come from the font. A leading
  // \xF8 in `unit` is stripped here and drawn as a small ring instead.
  bool degree = (unit && (uint8_t)unit[0] == 0xF8);
  const char *unitText = degree ? unit + 1 : unit;

  char combined[24];
  snprintf(combined, sizeof(combined), "%s%s", value, unitText);

  const GFXfont *font = pickFont(combined, availW, availH, degree ? 10 : 0);
  if (font) {
    canvas.setFont(font);
    canvas.setTextSize(1);
  } else {
    canvas.setFont(nullptr);
    canvas.setTextSize(fitSize(combined, availW, availH, maxSize));
  }

  int16_t vx1, vy1, ux1, uy1;
  uint16_t vw, vh, uw, uh;
  canvas.getTextBounds(value, 0, 0, &vx1, &vy1, &vw, &vh);
  canvas.getTextBounds(unitText, 0, 0, &ux1, &uy1, &uw, &uh);

  int r = vh / 9;
  if (r < 2) r = 2;                       // degree-ring radius scales with the digits
  int degW = degree ? (2 * r + 4) : 0;    // ring + breathing room

  int totalW = vw + degW + uw;
  int startX = cx - totalW / 2;
  int baseY = cy - vh / 2;

  canvas.setTextColor(valueColor);
  canvas.setCursor(startX - vx1, baseY - vy1);
  canvas.print(value);

  if (degree) {
    int dcx = startX + vw + 2 + r;
    int dcy = baseY + r;
    canvas.drawCircle(dcx, dcy, r, unitColor);
    canvas.drawCircle(dcx, dcy, r - 1, unitColor); // doubled ring so it reads at size
  }

  canvas.setTextColor(unitColor);
  canvas.setCursor(startX + vw + degW - ux1, baseY - uy1);
  canvas.print(unitText);

  canvas.setFont(nullptr); // restore the built-in font for small labels/tags
}

void drawTag(const char *text, uint16_t color, int cx, int cy, uint8_t size) {
  canvas.setFont(nullptr); // tags always use the built-in small font
  canvas.setTextSize(size);
  int16_t x1, y1;
  uint16_t w, h;
  canvas.getTextBounds(text, 0, 0, &x1, &y1, &w, &h);
  canvas.setTextColor(color, BG_BLACK);
  canvas.setCursor(cx - w / 2 - x1, cy - h / 2 - y1);
  canvas.print(text);
}

void hline(int x, int y, int w, uint16_t color) { canvas.drawFastHLine(x, y, w, color); }

void drawDots(uint8_t activeIndex, uint8_t total) {
  if (total == 0) return;
  const int r = 1;
  const int gap = 6;
  int totalW = (total - 1) * gap;
  int startX = (TFT_W - totalW) / 2;
  int y = TFT_H - 4;
  for (uint8_t i = 0; i < total; i++) {
    uint16_t c = (i == activeIndex) ? DOT_ON : DOT_DIM;
    canvas.fillCircle(startX + i * gap, y, r, c);
  }
}

void drawGraph(int x, int y, int w, int h, const Series *series, uint8_t seriesCount) {
  canvas.drawFastHLine(x, y + h / 2, w, LINE_COLOR);
  for (uint8_t s = 0; s < seriesCount; s++) {
    const Series &sr = series[s];
    if (sr.count < 2) continue;
    float mn = sr.data[0], mx = sr.data[0];
    for (uint8_t i = 1; i < sr.count; i++) {
      if (sr.data[i] < mn) mn = sr.data[i];
      if (sr.data[i] > mx) mx = sr.data[i];
    }
    float span = (mx - mn);
    if (span < 0.0001f) span = 1.0f;

    int prevX = x, prevY = y;
    for (uint8_t i = 0; i < sr.count; i++) {
      int px = x + (int)((float)i / (sr.count - 1) * w);
      int py = y + h - (int)((sr.data[i] - mn) / span * h);
      if (i > 0) {
        canvas.drawLine(prevX, prevY, px, py, sr.color);
        if (sr.fill) canvas.drawLine(px, py, px, y + h, sr.color);
      }
      prevX = px;
      prevY = py;
      if (i == sr.count - 1) canvas.fillCircle(px, py, 2, sr.color);
    }
  }
}

void playBootAnimation() {
  tft.fillScreen(WHITE);
  int lx = (TFT_W - LOGO_W) / 2;
  int ly = (TFT_H - LOGO_H) / 2 - 6;
  tft.drawRGBBitmap(lx, ly, LOGO_BITMAP, LOGO_W, LOGO_H);

  const int barW = 60, barH = 2;
  int barX = (TFT_W - barW) / 2;
  int barY = ly + LOGO_H + 14;
  tft.drawRect(barX - 1, barY - 1, barW + 2, barH + 2, 0xC618); // faint track outline
  tft.fillRect(barX, barY, barW, barH, WHITE);

  uint32_t start = millis();
  int lastFilled = 0;
  while (millis() - start < BOOT_BAR_MS) {
    float t = (float)(millis() - start) / BOOT_BAR_MS;
    int filled = (int)(t * barW);
    if (filled > lastFilled) {
      tft.fillRect(barX + lastFilled, barY, filled - lastFilled, barH, V_COLOR);
      lastFilled = filled;
    }
  }
  tft.fillRect(barX, barY, barW, barH, V_COLOR);
  delay(BOOT_HOLD_MS);
}

} // namespace Display

// ============================================================
//  FIXED-WIDTH NUMBER FORMATTING
// ============================================================
void fmtFixed(char *buf, size_t bufSize, float value, uint8_t intDigits, uint8_t decDigits) {
  bool neg = value < 0;
  if (neg) value = -value;

  long scale = 1;
  for (uint8_t i = 0; i < decDigits; i++) scale *= 10;

  long scaled = (long)(value * scale + 0.5f);
  long intPart = scaled / scale;
  long fracPart = scaled % scale;

  if (decDigits > 0) {
    snprintf(buf, bufSize, "%s%0*ld.%0*ld", neg ? "-" : "", intDigits, intPart, decDigits, fracPart);
  } else {
    snprintf(buf, bufSize, "%s%0*ld", neg ? "-" : "", intDigits, intPart);
  }
}

void fmtVoltage(char *buf, size_t bufSize, float v) { fmtFixed(buf, bufSize, v, 2, 3); }
void fmtCurrent(char *buf, size_t bufSize, float a) { fmtFixed(buf, bufSize, a, 1, 4); }

void fmtPower(char *buf, size_t bufSize, float w) {
  if (w < 10.0f) fmtFixed(buf, bufSize, w, 1, 4);
  else if (w < 100.0f) fmtFixed(buf, bufSize, w, 2, 3);
  else fmtFixed(buf, bufSize, w, 3, 2);
}

void fmtMah(char *buf, size_t bufSize, float mah) { fmtFixed(buf, bufSize, mah, 4, 0); }
void fmtWh(char *buf, size_t bufSize, float wh) { fmtFixed(buf, bufSize, wh, 2, 2); }
void fmtTemp(char *buf, size_t bufSize, float c) { fmtFixed(buf, bufSize, c, 2, 1); }

void fmtHMS(char *buf, size_t bufSize, uint32_t totalSeconds) {
  uint32_t h = totalSeconds / 3600;
  uint32_t m = (totalSeconds % 3600) / 60;
  uint32_t s = totalSeconds % 60;
  snprintf(buf, bufSize, "%02lu:%02lu:%02lu", (unsigned long)h, (unsigned long)m, (unsigned long)s);
}

// ============================================================
//  POWER SENSOR — PAC1811 wrapper (via the PAC1xxx library) + SAMD21 temp
// ============================================================
namespace PowerSensor {

static PAC1xxx pac;
static TemperatureZero tempZero;
static Readings r;

static uint32_t lastSampleMs = 0;
static uint32_t lastHistMs = 0;
static uint32_t sessionStartMs = 0;
static uint32_t sampleCount = 0;
static double vSum = 0, iSum = 0, pSum = 0;

void reset(); // used by begin() below; defined further down

bool begin() {
  Wire.begin();

  if (!pac.begin(PAC1811_I2C_ADDR)) {
    return false;
  }
  pac.setShuntMilliOhms(PAC1811_SHUNT_MOHM);

  // The chip can accumulate either power or sense charge, not both, so it
  // accumulates charge (mAh) and Wh is derived in update() from that plus
  // the running average bus voltage.
  pac.setAccumulateMode(PAC1XXX_ACC_SENSE);
  pac.refresh(); // apply config, latch/reset the accumulator baseline

  tempZero.init();

  reset();
  return true;
}

void reset() {
  r = Readings(); // re-run default member initializers, avoids memset-on-non-POD warning
  vSum = iSum = pSum = 0;
  sampleCount = 0;
  sessionStartMs = millis();
  lastHistMs = 0;
  pac.refresh(); // also clears the hardware charge accumulator
}

void update() {
  uint32_t now = millis();
  if (now - lastSampleMs < SAMPLE_INTERVAL_MS) return;
  lastSampleMs = now;

  float v = pac.busVoltage();
  float i = pac.current();
  float p = pac.power();
  if (isnan(v) || isnan(i) || isnan(p)) return; // skip a bad/glitched sample

  r.voltage = v;
  r.current = i;
  r.power = p;

  if (sampleCount == 0 || v < r.vMin) r.vMin = v;
  if (sampleCount == 0 || v > r.vMax) r.vMax = v;
  if (sampleCount == 0 || i < r.iMin) r.iMin = i;
  if (sampleCount == 0 || i > r.iMax) r.iMax = i;
  if (sampleCount == 0 || p < r.pMin) r.pMin = p;
  if (sampleCount == 0 || p > r.pMax) r.pMax = p;

  vSum += v;
  iSum += i;
  pSum += p;
  sampleCount++;
  r.vAvg = vSum / sampleCount;
  r.iAvg = iSum / sampleCount;
  r.pAvg = pSum / sampleCount;

  // refresh() latches and clears the charge accumulated since the previous
  // call, so summing the results here gives a running mAh total with no
  // gap between polls.
  pac.refresh();
  r.mAh += pac.charge_mAh();
  r.Wh = (r.mAh / 1000.0f) * r.vAvg;

  // The die-temperature read is a 64-sample averaged ADC conversion that
  // blocks for ~25ms. At the 100ms sample cadence that would consume a
  // quarter of all loop time, so it runs once a second instead.
  static uint32_t lastTempMs = 0;
  if (now - lastTempMs >= 1000) {
    lastTempMs = now;
    r.temperatureC = tempZero.readInternalTemperature();
  }
  r.sessionSeconds = (now - sessionStartMs) / 1000;

  // Graph history: one point per second, oldest-first ring shifted in place.
  if (now - lastHistMs >= 1000) {
    lastHistMs = now;
    if (r.histCount < GRAPH_POINTS) {
      r.vHist[r.histCount] = v;
      r.iHist[r.histCount] = i;
      r.pHist[r.histCount] = p;
      r.histCount++;
    } else {
      memmove(r.vHist, r.vHist + 1, (GRAPH_POINTS - 1) * sizeof(float));
      memmove(r.iHist, r.iHist + 1, (GRAPH_POINTS - 1) * sizeof(float));
      memmove(r.pHist, r.pHist + 1, (GRAPH_POINTS - 1) * sizeof(float));
      r.vHist[GRAPH_POINTS - 1] = v;
      r.iHist[GRAPH_POINTS - 1] = i;
      r.pHist[GRAPH_POINTS - 1] = p;
    }
  }
}

const Readings &data() { return r; }

} // namespace PowerSensor

// ============================================================
//  SCREENS — draw functions + the rearrange/enable/disable registry
// ============================================================
namespace Screens {

// One row of a big-digit screen: a value string, its unit, and the two
// colours drawValueUnit() needs (full-bright value, dimmed unit).
struct VU {
  const char *value;
  const char *unit;
  uint16_t color;
  uint16_t colorDim;
};

static const int DOTS_MARGIN = 7; // bottom strip reserved for the page dots

// Every screen is composed into the shared off-screen canvas and pushed
// to the panel in one operation via Display::present(). The live panel is
// never cleared directly.

static void drawTriple(const VU rows[3], const char *tag, uint8_t dotIndex, uint8_t dotTotal) {
  int contentH = TFT_H - DOTS_MARGIN;
  int tagH = tag ? 13 : 0;
  int rowsH = contentH - tagH;
  int rowH = rowsH / 3;
  int extra = rowsH - rowH * 3;

  Display::clearScreen();
  int y = 0;
  if (tag) {
    Display::drawTag(tag, LABEL_COLOR, TFT_W / 2, tagH / 2, 1);
    y = tagH;
  }
  for (uint8_t i = 0; i < 3; i++) {
    int thisH = rowH + (i == 2 ? extra : 0);
    Display::drawValueUnit(rows[i].value, rows[i].unit, rows[i].color, rows[i].colorDim,
                            TFT_W / 2, y + thisH / 2, TFT_W - 10, thisH - 2, 8);
    y += thisH;
  }
  Display::drawDots(dotIndex, dotTotal);
  Display::present();
}

static void drawDuo(const VU &a, const VU &b, uint8_t dotIndex, uint8_t dotTotal) {
  Display::clearScreen();
  int contentH = TFT_H - DOTS_MARGIN;
  int rowH = contentH / 2;

  // availH = rowH-2 rather than rowH-4: those 2px are what let the 24pt
  // face (~34px digits) qualify on the temperature readout.
  Display::drawValueUnit(a.value, a.unit, a.color, a.colorDim, TFT_W / 2, rowH / 2, TFT_W - 14, rowH - 2, 8);
  Display::hline(14, rowH, TFT_W - 28, LINE_COLOR);
  Display::drawValueUnit(b.value, b.unit, b.color, b.colorDim, TFT_W / 2, rowH + rowH / 2, TFT_W - 14, rowH - 2, 8);

  Display::drawDots(dotIndex, dotTotal);
  Display::present();
}

static void drawGraphScreen(const char *label, const char *val, const char *unit, uint16_t color,
                             const float *hist, uint8_t histCount, uint8_t dotIndex, uint8_t dotTotal) {
  Display::clearScreen();
  Display::drawTag(label, LABEL_COLOR, TFT_W / 2, 5, 1);
  Display::drawValueUnit(val, unit, color, color, TFT_W / 2, 17, TFT_W - 20, 14, 6); // 14px: tall enough for the 9pt face

  Display::Series s = {hist, histCount, color, true};
  Display::drawGraph(5, 26, TFT_W - 10, TFT_H - 26 - DOTS_MARGIN, &s, 1);
  Display::drawDots(dotIndex, dotTotal);
  Display::present();
}

// ---------------- individual screens ----------------

static void draw_VIP(const Readings &r, uint8_t idx, uint8_t total) {
  char v[10], i[10], p[10];
  fmtVoltage(v, sizeof(v), r.voltage);
  fmtCurrent(i, sizeof(i), r.current);
  fmtPower(p, sizeof(p), r.power);
  VU rows[3] = {
      {v, "V", V_COLOR, V_COLOR_DIM},
      {i, "A", I_COLOR, I_COLOR_DIM},
      {p, "W", P_COLOR, P_COLOR_DIM},
  };
  drawTriple(rows, nullptr, idx, total);
}

static void draw_VImAh(const Readings &r, uint8_t idx, uint8_t total) {
  char v[10], i[10], m[10];
  fmtVoltage(v, sizeof(v), r.voltage);
  fmtCurrent(i, sizeof(i), r.current);
  fmtMah(m, sizeof(m), r.mAh);
  VU rows[3] = {
      {v, "V", V_COLOR, V_COLOR_DIM},
      {i, "A", I_COLOR, I_COLOR_DIM},
      {m, "mAh", MAH_COLOR, MAH_COLOR_DIM},
  };
  drawTriple(rows, nullptr, idx, total);
}

static void draw_VIWh(const Readings &r, uint8_t idx, uint8_t total) {
  char v[10], i[10], w[10];
  fmtVoltage(v, sizeof(v), r.voltage);
  fmtCurrent(i, sizeof(i), r.current);
  fmtWh(w, sizeof(w), r.Wh);
  VU rows[3] = {
      {v, "V", V_COLOR, V_COLOR_DIM},
      {i, "A", I_COLOR, I_COLOR_DIM},
      {w, "Wh", WH_COLOR, WH_COLOR_DIM},
  };
  drawTriple(rows, nullptr, idx, total);
}

static void draw_TempSession(const Readings &r, uint8_t idx, uint8_t total) {
  char t[10], hms[12];
  fmtTemp(t, sizeof(t), r.temperatureC);
  fmtHMS(hms, sizeof(hms), r.sessionSeconds);
  VU a = {t, "\xF8"
              "C",
          T_COLOR, T_COLOR_DIM}; // \xF8 = degree glyph in the built-in CP437 font
  VU b = {hms, "", WH_COLOR, WH_COLOR_DIM};
  drawDuo(a, b, idx, total);
}

static void draw_Min(const Readings &r, uint8_t idx, uint8_t total) {
  char v[10], i[10], p[10];
  fmtVoltage(v, sizeof(v), r.vMin);
  fmtCurrent(i, sizeof(i), r.iMin);
  fmtPower(p, sizeof(p), r.pMin);
  VU rows[3] = {{v, "V", V_COLOR, V_COLOR_DIM}, {i, "A", I_COLOR, I_COLOR_DIM}, {p, "W", P_COLOR, P_COLOR_DIM}};
  drawTriple(rows, "MIN", idx, total);
}

static void draw_Max(const Readings &r, uint8_t idx, uint8_t total) {
  char v[10], i[10], p[10];
  fmtVoltage(v, sizeof(v), r.vMax);
  fmtCurrent(i, sizeof(i), r.iMax);
  fmtPower(p, sizeof(p), r.pMax);
  VU rows[3] = {{v, "V", V_COLOR, V_COLOR_DIM}, {i, "A", I_COLOR, I_COLOR_DIM}, {p, "W", P_COLOR, P_COLOR_DIM}};
  drawTriple(rows, "MAX", idx, total);
}

static void draw_Avg(const Readings &r, uint8_t idx, uint8_t total) {
  char v[10], i[10], p[10];
  fmtVoltage(v, sizeof(v), r.vAvg);
  fmtCurrent(i, sizeof(i), r.iAvg);
  fmtPower(p, sizeof(p), r.pAvg);
  VU rows[3] = {{v, "V", V_COLOR, V_COLOR_DIM}, {i, "A", I_COLOR, I_COLOR_DIM}, {p, "W", P_COLOR, P_COLOR_DIM}};
  drawTriple(rows, "AVG", idx, total);
}

static void draw_GraphV(const Readings &r, uint8_t idx, uint8_t total) {
  char v[10];
  fmtVoltage(v, sizeof(v), r.voltage);
  drawGraphScreen("VOLTAGE", v, "V", V_COLOR, r.vHist, r.histCount, idx, total);
}

static void draw_GraphI(const Readings &r, uint8_t idx, uint8_t total) {
  char i[10];
  fmtCurrent(i, sizeof(i), r.current);
  drawGraphScreen("CURRENT", i, "A", I_COLOR, r.iHist, r.histCount, idx, total);
}

static void draw_GraphP(const Readings &r, uint8_t idx, uint8_t total) {
  char p[10];
  fmtPower(p, sizeof(p), r.power);
  drawGraphScreen("POWER", p, "W", P_COLOR, r.pHist, r.histCount, idx, total);
}

static void draw_GraphCombined(const Readings &r, uint8_t idx, uint8_t total) {
  Display::clearScreen();
  Display::drawTag("VOLT + CURR", LABEL_COLOR, TFT_W / 2, 5, 1);

  char v[10], i[10];
  fmtVoltage(v, sizeof(v), r.voltage);
  fmtCurrent(i, sizeof(i), r.current);
  // two short value groups side by side on the same line
  Display::drawValueUnit(v, "V", V_COLOR, V_COLOR_DIM, TFT_W / 2 - 20, 17, 40, 12, 5);
  Display::drawValueUnit(i, "A", I_COLOR, I_COLOR_DIM, TFT_W / 2 + 20, 17, 40, 12, 5);

  Display::Series series[2] = {
      {r.vHist, r.histCount, V_COLOR, true},
      {r.iHist, r.histCount, I_COLOR, false},
  };
  Display::drawGraph(5, 26, TFT_W - 10, TFT_H - 26 - DOTS_MARGIN, series, 2);
  Display::drawDots(idx, total);
  Display::present();
}

// ============================================================
//  SCREEN REGISTRY — edit this array to rearrange / enable /
//  disable screens. Navigation order follows array order; set
//  `enabled = false` to hide a screen from Next/Prev without
//  deleting its code. Nothing else in the sketch needs to change.
// ============================================================
typedef void (*DrawFn)(const Readings &, uint8_t, uint8_t);
struct ScreenDef {
  const char *name;
  DrawFn draw;
  bool enabled;
};

static ScreenDef SCREENS[] = {
    {"V / I / P", draw_VIP, true},
    {"V / I / mAh", draw_VImAh, true},
    {"V / I / Wh", draw_VIWh, true},
    {"Temp / Session", draw_TempSession, true},
    {"Min (V/I/P)", draw_Min, true},
    {"Max (V/I/P)", draw_Max, true},
    {"Avg (V/I/P)", draw_Avg, true},
    {"Voltage graph", draw_GraphV, true},
    {"Current graph", draw_GraphI, true},
    {"Power graph", draw_GraphP, true},
    {"Combined V+I graph", draw_GraphCombined, true},
};
static const uint8_t SCREEN_COUNT = sizeof(SCREENS) / sizeof(SCREENS[0]);

static int8_t currentScreen = -1;

static uint8_t countEnabled() {
  uint8_t n = 0;
  for (uint8_t i = 0; i < SCREEN_COUNT; i++)
    if (SCREENS[i].enabled) n++;
  return n;
}

static uint8_t enabledPositionOf(int8_t screenIndex) {
  uint8_t pos = 0;
  for (uint8_t i = 0; i < screenIndex; i++)
    if (SCREENS[i].enabled) pos++;
  return pos;
}

void begin() {
  currentScreen = 0;
  while (currentScreen < SCREEN_COUNT - 1 && !SCREENS[currentScreen].enabled) currentScreen++;
}

void next() {
  if (SCREEN_COUNT == 0) return;
  uint8_t start = currentScreen;
  do {
    currentScreen = (currentScreen + 1) % SCREEN_COUNT;
  } while (!SCREENS[currentScreen].enabled && currentScreen != start);
}

void prev() {
  if (SCREEN_COUNT == 0) return;
  uint8_t start = currentScreen;
  do {
    currentScreen = (currentScreen + SCREEN_COUNT - 1) % SCREEN_COUNT;
  } while (!SCREENS[currentScreen].enabled && currentScreen != start);
}

void draw(const Readings &r) {
  if (currentScreen < 0 || currentScreen >= SCREEN_COUNT) return;
  if (!SCREENS[currentScreen].enabled) {
    Display::clearScreen();
    Display::drawTag("ALL SCREENS", LABEL_COLOR, TFT_W / 2, TFT_H / 2 - 8, 1);
    Display::drawTag("DISABLED", LABEL_COLOR, TFT_W / 2, TFT_H / 2 + 8, 1);
    Display::present();
    return;
  }
  uint8_t total = countEnabled();
  uint8_t pos = enabledPositionOf(currentScreen);
  SCREENS[currentScreen].draw(r, pos, total);
}

} // namespace Screens

// ============================================================
//  BUTTONS
// ============================================================
// PA13 pages forward, PA15 pages back. PA14 flips the display 180° on a
// tap and resets the session on a 1.5s hold.
const unsigned long DEBOUNCE_MS = 25;
const unsigned long HOLD_MS = 1500;

Button btnNext = { SW_NEXT_BIT };
Button btnPrev = { SW_PREV_BIT };
Button btnRot  = { SW_ROT_BIT };

bool needFullRedraw = false;

// returns true on press edge (debounced)
bool pollEdge(Button &b, bool &releaseEdge) {
  releaseEdge = false;
  bool raw = gpioActiveLow(b.pinBit);
  unsigned long now = millis();
  if (raw != b.lastRaw) {
    b.lastRaw = raw;
    b.lastChangeMs = now;
  }
  if ((now - b.lastChangeMs) > DEBOUNCE_MS && b.stable != raw) {
    b.stable = raw;
    if (b.stable) {
      return true; // press edge
    } else {
      releaseEdge = true;
    }
  }
  return false;
}

void handleButtons() {
  bool rel;

  if (pollEdge(btnNext, rel)) {
    Screens::next();
    needFullRedraw = true;
  }

  if (pollEdge(btnPrev, rel)) {
    Screens::prev();
    needFullRedraw = true;
  }

  // PA14: tap = flip 180°, hold 1.5s = reset
  bool relRot;
  bool pressedRot = pollEdge(btnRot, relRot);
  if (pressedRot) {
    btnRot.pressStartMs = millis();
    btnRot.holdFired = false;
  }
  if (btnRot.stable && !btnRot.holdFired) {
    if (millis() - btnRot.pressStartMs >= HOLD_MS) {
      btnRot.holdFired = true;
      PowerSensor::reset();
      needFullRedraw = true;
    }
  }
  if (relRot && !btnRot.holdFired) {
    // tap: flip the display 180°
    Display::toggleFlip();
    needFullRedraw = true;
  }
}

// ============================================================
//  SETUP / LOOP
// ============================================================
const unsigned long TICK_MS = 500; // display refresh cadence

void setup() {
  gpioInput(SW_NEXT_BIT);
  gpioInput(SW_PREV_BIT);
  gpioInput(SW_ROT_BIT);

  Serial.begin(115200);

  Display::begin();
  Display::applyRotation();
  Display::playBootAnimation();

  if (!PowerSensor::begin()) {
    // PAC1811 did not answer on I2C — report it rather than showing a
    // blank or garbled screen.
    Display::clearScreen();
    Display::drawTag("PAC1811", 0xF800, TFT_W / 2, TFT_H / 2 - 8, 1);
    Display::drawTag("NOT FOUND", 0xF800, TFT_W / 2, TFT_H / 2 + 8, 1);
    Display::present();
    while (1) { delay(1000); }
  }

  Screens::begin();
  Screens::draw(PowerSensor::data());
}

void loop() {
  handleButtons();
  PowerSensor::update();

  static unsigned long lastDraw = 0;
  unsigned long now = millis();
  if (needFullRedraw || (now - lastDraw) >= TICK_MS) {
    // Clear the flag before drawing: present() polls buttons mid-frame,
    // and a press landing during the blit must not be discarded afterwards.
    needFullRedraw = false;
    Screens::draw(PowerSensor::data());
    lastDraw = now;
  }
}